## components/IMU/Kconfig
```kconfig
menu "Flyhero IMU"

	config FLYHERO_IMU_USE_SOFT_LPF
		bool "Use software LPF"
		default y

	config FLYHERO_IMU_ACCEL_SOFT_LPF
		int "Accelerometer software LPF"
		range 1 1000
		default 10
		depends on FLYHERO_IMU_USE_SOFT_LPF

	config FLYHERO_IMU_GYRO_SOFT_LPF
		int "Gyroscope software LPF"
		range 1 1000
		default 60
		depends on FLYHERO_IMU_USE_SOFT_LPF

	choice FLYHERO_IMU_HARD_LPF
		prompt "Hardware LPF"
		default FLYHERO_IMU_HARD_LPF_256HZ

		config FLYHERO_IMU_HARD_LPF_256HZ
			bool "256 Hz"
		config FLYHERO_IMU_HARD_LPF_188HZ
			bool "188 Hz"
		config FLYHERO_IMU_HARD_LPF_98HZ
			bool "98 Hz"
		config FLYHERO_IMU_HARD_LPF_42HZ
			bool "42 Hz"
		config FLYHERO_IMU_HARD_LPF_20HZ
			bool "20 Hz"
		config FLYHERO_IMU_HARD_LPF_10HZ
			bool "10 Hz"
		config FLYHERO_IMU_HARD_LPF_5HZ
			bool "5 Hz"

	endchoice

	choice FLYHERO_IMU_ACCEL_FSR
		prompt "Accelerometer full-scale range"
		default FLYHERO_IMU_ACCEL_FSR_16

		config FLYHERO_IMU_ACCEL_FSR_16
			bool "+- 16g"
		config FLYHERO_IMU_ACCEL_FSR_8
			bool "+- 8g"
		config FLYHERO_IMU_ACCEL_FSR_4
			bool "+- 4g"
		config FLYHERO_IMU_ACCEL_FSR_2
			bool "+- 2g"

	endchoice

	choice FLYHERO_IMU_GYRO_FSR
		prompt "Gyroscope full-scale range"
		default FLYHERO_IMU_GYRO_FSR_2000

		config FLYHERO_IMU_GYRO_FSR_2000
			bool "+- 2000 deg/sec"
		config FLYHERO_IMU_GYRO_FSR_1000
			bool "+- 1000 deg/sec"
		config FLYHERO_IMU_GYRO_FSR_500
			bool "+- 500 deg/sec"
		config FLYHERO_IMU_GYRO_FSR_250
			bool "+- 250 deg/sec"

	endchoice

endmenu
```

## components/WiFi/Kconfig
```kconfig
menu "Flyhero WiFi"

	config FLYHERO_WIFI_TCP_PORT
		int "TCP port"
		default 4821

	config FLYHERO_WIFI_UDP_PORT
		int "UDP port"
		default 4789

	config FLYHERO_WIFI_SSID
		string "SSID"
		default "DRONE WIFI"

	config FLYHERO_WIFI_SSID_VISIBLE
		bool "SSID visible"
		default y

	config FLYHERO_WIFI_WPA2_PASSPHRASE
		string "WPA2 passphrase"
		default flyhero

endmenu
```
